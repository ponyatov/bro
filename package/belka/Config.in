## package/belka/Config.in
```kconfig
config BR2_PACKAGE_BELKA
	bool "Belka Vending platform"
	default y
	help
		Belka Vending platform

if BR2_PACKAGE_BELKA

config BR2_PACKAGE_BELKA_X
	bool "XWindow system"
	default y
	select BR2_PACKAGE_GUI

endif
```

## package/flask/Config.in
```kconfig
config BR2_PACKAGE_FLASK
	bool "Flask web platform server"
	default n
	select BR2_TOOLCHAIN_BUILDROOT_WCHAR
	select BR2_PACKAGE_PYTHON
	select BR2_PACKAGE_PYTHON_FLASK
	select BR2_PACKAGE_PYTHON_FLASK_WTF
	select BR2_PACKAGE_PYTHON_WTFORMS
	help
		Flask web platform server
```

## package/gui/Config.in
```kconfig
config BR2_PACKAGE_GUI
	bool "X Window system GUI"
	default n
	select BR2_TOOLCHAIN_BUILDROOT_WCHAR
	select BR2_PACKAGE_XORG7
	select BR2_PACKAGE_XSERVER_XORG_SERVER
	select BR2_PACKAGE_XSERVER_XORG_SERVER_KDRIVE_EVDEV
	select BR2_PACKAGE_XSERVER_XORG_SERVER_KDRIVE_KBD
	select BR2_PACKAGE_XSERVER_XORG_SERVER_KDRIVE_MOUSE
	select BR2_PACKAGE_XTERM
	select BR2_PACKAGE_XAPP_XCLOCK
	select BR2_PACKAGE_XAPP_TWM
#	select BR2_PACKAGE_XVKBD
#	select BR2_PACKAGE_XDRIVER_XF86_VIDEO_CIRRUS
#	select BR2_PACKAGE_XDRIVER_XF86_VIDEO_FBDEV
#	select BR2_PACKAGE_XDRIVER_XF86_VIDEO_VESA
	help
		Embedded GUI subsystem
```

## package/hello/Config.in
```kconfig
config BR2_PACKAGE_HELLO
	bool "Hello World"
	default y
	help
		test Buildroot system for libs and functions

if BR2_PACKAGE_HELLO

config BR2_PACKAGE_HELLO_CPP
	bool "c++"
	default n
	select BR2_TOOLCHAIN_BUILDROOT_CXX

config BR2_PACKAGE_HELLO_PTHREAD
	bool "pthread"
	default n
	depends on BR2_PTHREADS_NATIVE

endif
```

## package/kiosk/Config.in
```kconfig
config BR2_PACKAGE_KIOSK
	bool "Kiosk"
#	select BR2_PACKAGE_GUI

	select BR2_TOOLCHAIN_BUILDROOT_CXX
	select BR2_PACKAGE_DIRECTFB
	select BR2_PACKAGE_LINKS
	select BR2_PACKAGE_LINKS_GRAPHICS
	
	select BR2_PACKAGE_FLASK
	select BR2_PACKAGE_PYTHON_READLINE
	select BR2_PACKAGE_PYTHON_PLY
	help
		generic internet kiosk / POS terminal
	
```

## package/python-flask-wtf/Config.in
```kconfig
config BR2_PACKAGE_PYTHON_FLASK_WTF
	bool "python-flask-wtf"
	depends on BR2_PACKAGE_PYTHON_FLASK
	help
		WTForms interface for Flask
```

## package/python-flask_wtf/Config.in
```kconfig
config BR2_PACKAGE_PYTHON_FLASK_WTF
	bool "python-flask_wtf"
	depends on BR2_PACKAGE_PYTHON_FLASK
	help
		WTForms interface for Flask
```

## package/python-wtforms/Config.in
```kconfig
config BR2_PACKAGE_PYTHON_WTFORMS
	bool "python-wtforms"
	help
		WTForms interface
```
